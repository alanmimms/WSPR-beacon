## components/si5351/Kconfig.projbuild
```kconfig
menu "SI5351 I2C Configuration"

    config I2C_MASTER_SCL
	int "SCL GPIO Num"
	default 4
	help
	    GPIO number for I2C Master clock line.

    config I2C_MASTER_SDA
	int "SDA GPIO Num"
	default 5
	help
	    GPIO number for I2C Master data line.

    config I2C_MASTER_FREQUENCY
	int "Master Frequency"
	default 100000
	help
	    I2C Speed of Master device.

    config I2C_PORT
    	   int "I2C port number on ESP32"
	   default -1
	   help
		It's unlikely you will need to change this from its
		default. This is the interface number on the ESP32
		microcontroller for the I2C bus to which the SI5351 is
		attached.

    config SI5351_ADDRESS
    	   hex "SI5351 I2C bus address"
	   default 60
	   help
		It's unlikely you will need to change this from its
		default. This is the 1..127 address of the SI5351
		device on the I2C bus.

endmenu
```
